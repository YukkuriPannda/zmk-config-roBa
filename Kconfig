## Kconfig
```kconfig
config ROBA_BATTERY_LED
	bool "Show the battery level on the XIAO onboard LED at startup"
	depends on ZMK_BATTERY_REPORTING
	help
	  起動後に最初のバッテリー測定値を受け取った時点で、XIAO BLE の
	  オンボード LED を残量に応じた色で一定時間だけ点灯させる。
	  左右それぞれが自分側の電池残量を表示する。

if ROBA_BATTERY_LED

config ROBA_BATTERY_LED_DURATION_MS
	int "How long the battery LED stays lit, in milliseconds"
	default 3000

config ROBA_BATTERY_LED_MID_PERCENT
	int "At or above this percentage the LED is green"
	default 60

config ROBA_BATTERY_LED_LOW_PERCENT
	int "Below this percentage the LED is red instead of yellow"
	default 20

endif # ROBA_BATTERY_LED

config ROBA_OS_LAYER_SWITCH
	bool "Select the base layer according to the USB-detected host OS"
	depends on ZMK_OS_DETECTION_USB
	help
	  zmk-feature-os-detectionがUSB列挙から検出したOSに応じて、MACレイヤー
	  (レイヤーID 1)をlocking付きで有効/無効にする。Windows・Linuxでは無効化
	  (Windowsベースのまま)、macOS・iOSでは有効化(MACベース)する。Unknown・
	  Androidでは何もしない(現在の選択を維持する)。SETTINGSレイヤーの手動
	  `&to 0` / `&to 1` もlocking付きでレイヤー状態を更新するため、自動選択より
	  後から手動操作すればそちらが優先される。
```

## config/west.yml
```yaml
manifest:
  remotes:
    - name: cormoran
      url-base: https://github.com/cormoran
    # 既存のリモートはそのまま維持
  projects:
    # すべてコミットSHAで固定している。
    # ブランチ追従(main / main+dya)にすると、このリポジトリを一切変更して
    # いなくても上流が動いた瞬間にビルドが壊れる。実際 2026-07-19 の
    # runtime-input-processor の更新で zmk_keymap_layer_activate の引数が変わり、
    # 4月まで通っていたビルドが 9月に失敗した。
    #
    # ここに並ぶSHAは 2026-09-14 時点のビルド対象の組み合わせ。
    # 上流を取り込むときは1つずつ上げて、そのつどCIを通すこと。

    # ZMK: DYA Studio 用カスタム RPC サブシステム付き cormoran fork
    # (branch: main+dya)
    - name: zmk
      remote: cormoran
      revision: e5c9b6915b56801193e359dd9bad4a167ce0d1b8
      import: app/west.yml

    # (branch: main)
    - name: zmk-pmw3610-driver
      remote: cormoran
      revision: 28a32bec3e22bbfbfc2469e096f65e84302211cf

    # DYA Studio モジュール（すべて cormoran リポジトリ / branch: main）
    - name: zmk-module-ble-management
      remote: cormoran
      revision: 57738cc4fc6ba80e82a7ac57741a0339cb186cd4
    - name: zmk-module-battery-history
      remote: cormoran
      revision: 307755dd2ad4d320e14de162e8e5ef018f29d929
    - name: zmk-module-settings-rpc
      remote: cormoran
      revision: 78f86df9e6c5edaf57bef3ccbd7f360cfdf49291
    - name: zmk-module-runtime-input-processor
      remote: cormoran
      revision: 43618985f8c9d5457cc333b7ca0733f2d361911e
    - name: zmk-feature-custom-settings
      remote: cormoran
      revision: c6a7fef3a3be3d3ace5de9a4b0628c6418cd1f3f
    - name: zmk-feature-os-detection
      remote: cormoran
      revision: 3052679f645b8fc1997275c2eaa6b86bdd55ca01
  self:
    path: config
```
